## sdkconfig.defaults
```kconfig
# CONFIG_ENABLE_MDNS=y
CONFIG_HTTPD_MAX_REQ_HDR_LEN=1024

#
# Serial flasher config
#
CONFIG_ESPTOOLPY_FLASHSIZE_1MB=y
# 2M Baud for firmware flashing
CONFIG_ESPTOOLPY_BAUD_2MB=y
# 115200 Baud for logging
CONFIG_ESPTOOLPY_MONITOR_BAUD_115200B=y

#
# Partition Table
#
# Uncomment this to enable OTA
#CONFIG_PARTITION_TABLE_TWO_OTA=y
#CONFIG_PARTITION_TABLE_FILENAME="partitions_two_ota.1MB.csv"

#
# ESP8266-specific
#
CONFIG_ESP8266_BOOT_COPY_APP=y

#
# Common ESP-related
#
# UART0 as RS485, GPIO0 as DE (Active low)
# UART1 as debug output, Tx only, on GPIO2
CONFIG_ESP_CONSOLE_UART_CUSTOM=y
CONFIG_ESP_CONSOLE_UART_CUSTOM_NUM_0=n
CONFIG_ESP_CONSOLE_UART_CUSTOM_NUM_1=y
# Baud of the debug output, 115200
CONFIG_ESP_CONSOLE_UART_BAUDRATE=115200

#
# LWIP
#
CONFIG_LWIP_IPV6=y
CONFIG_LWIP_IPV6_AUTOCONFIG=y
CONFIG_LWIP_LOCAL_HOSTNAME="modbus_rtu2tcp"
```
